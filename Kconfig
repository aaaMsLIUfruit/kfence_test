## Kconfig
```kconfig
#
# For a description of the syntax of this configuration file,
# see the file kconfig-language.txt in the NuttX tools repository.
#

config TESTING_KFENCE
	tristate "KFENCE validity test"
	depends on MM_KFENCE
	default n
	---help---
		Enable the KFENCE validity test. This test suite validates the
		KFENCE (Kernel Electric-Fence) memory error detection functionality
		by running various memory error test cases including:
		- CWE122: Heap-based buffer overflow
		- CWE415: Double free
		- CWE416: Use after free
		- Basic memory error tests (overflow, underflow, invalid access)

if TESTING_KFENCE

config TESTING_KFENCE_JULIET_CWE
	bool "Enable Juliet CWE test cases"
	default n
	---help---
		Enable the Juliet CWE (Common Weakness Enumeration) test cases.
		These are standardized test cases for common software security
		vulnerabilities including:
		- CWE415: Double free vulnerability tests
		- CWE416: Use after free vulnerability tests
		- Additional CWE test cases as they are implemented

config TESTING_KFENCE_PRIORITY
	int "KFENCE test priority"
	default 101
	---help---
		The priority of the KFENCE test task.

config TESTING_KFENCE_STACKSIZE
	int "KFENCE test stack size"
	default 1024
	---help---
		The stack size allocated for the KFENCE test task.

endif
```
